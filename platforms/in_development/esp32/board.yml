## platforms/in_development/esp32/board.yml
```yaml
# Ferqon board definition — ESP32
board: esp32
display_name: "ESP32 DevKit"
mcu: esp32
backend: arduino
pio_env: esp32

# Core & memory topology
core_count: 2
isr_serial_strategy: multicore
ram_size_bytes: 520000
flash_size_bytes: 4194304
sys_clock_hz: 240000000
multicore: true

# GPIO
max_gpio: 39
led_pin: 2
reserved_pins: [6, 7, 8, 11, 20, 24, 28, 29, 30, 31]

# ADC
adc:
  pins: [32, 33, 34, 35, 36, 39]
  resolution_bits: 12
  vref_mv: 3300

# PWM
pwm:
  pins: [0, 1, 2, 3, 4, 5, 6, 7, 8, 9, 10, 11, 12, 13, 14, 15, 16, 17, 18, 19, 20, 21, 22, 23, 24, 25, 26, 27, 32, 33]

# Peripherals
spi:
  - instance: 0
    sck:  [18]
    mosi: [23]
    miso: [19]
    cs:   [5]
  - instance: 1
    sck:  [14]
    mosi: [13]
    miso: [12]
    cs:   [15]

i2c:
  - {instance: 0, sda: [21], scl: [22]}

uart:
  - {instance: 0, tx: [1], rx: [3]}
  - {instance: 1, tx: [10], rx: [9]}

# Advanced / optional
pio_blocks: 0
pio_sm_per_block: 0
dma_channels: 0

# Network capabilities (for protocol subsystem)
network:
  link: [wifi]
  transport: [mqtt, serial]
  ota: true
  provision: [softap]

# Versioning
device_type: "esp32-devkit"
protocol_version: "2.0"
capability_version: "1.0"
firmware_version: "1.0.0"

# Human notes
notes: |
  Standard ESP32 DevKit configuration.
  WiFi and OTA support available.
```

## platforms/in_development/mega2560/board.yml
```yaml
# SPDX-License-Identifier: Apache-2.0
# SPDX-FileCopyrightText: Copyright (c) 2026 Revyr Labs
# Ferqon board definition — Arduino Mega 2560 (ATmega2560)
board: mega2560
display_name: "Arduino Mega 2560"
mcu: atmega2560
backend: arduino
pio_env: mega2560

# Core & memory topology
core_count: 1
isr_serial_strategy: uart_rx_isr
ram_size_bytes: 8192
flash_size_bytes: 253952
sys_clock_hz: 16000000
multicore: false

# GPIO
max_gpio: 69
led_pin: 13
reserved_pins: [0, 1]

# ADC
adc:
  pins: [54, 55, 56, 57, 58, 59, 60, 61, 62, 63, 64, 65, 66, 67, 68, 69]
  resolution_bits: 10
  vref_mv: 5000

# PWM
pwm:
  pins: [2, 3, 4, 5, 6, 7, 8, 9, 10, 11, 12, 13, 44, 45, 46]

# Peripherals
spi:
  - instance: 0
    sck: [52]
    mosi: [51]
    miso: [50]
    cs: [53]

i2c:
  - {instance: 0, sda: [20], scl: [21]}

uart:
  - {instance: 0, tx: [1], rx: [0]}
  - {instance: 1, tx: [18], rx: [19]}
  - {instance: 2, tx: [16], rx: [17]}
  - {instance: 3, tx: [14], rx: [15]}

# Advanced / optional
pio_blocks: 0
pio_sm_per_block: 0
dma_channels: 0

# Network capabilities
network:
  link: []
  transport: [serial]
  ota: false
  provision: []

# Versioning
device_type: "arduino-mega2560"
protocol_version: "1.1.0"
capability_version: "1.0"
firmware_version: "1.1.0"

notes: |
  Arduino Mega 2560 with ATmega2560.
  Has 4 hardware UARTs (Serial, Serial1, Serial2, Serial3).
  Pins 0-1 reserved (Serial0 RX/TX).
  ADC pins are A0-A15 (digital 54-69).
  54 digital pins + 16 analog pins.
```

## platforms/in_development/rp2040/board.yml
```yaml
# SPDX-License-Identifier: Apache-2.0
# SPDX-FileCopyrightText: Copyright (c) 2026 Revyr Labs
# Ferqon board definition — Generic RP2040
board: rp2040
display_name: "Generic RP2040"
mcu: rp2040
backend: arduino
pio_env: rp2040

# Core & memory topology
core_count: 2
isr_serial_strategy: multicore
ram_size_bytes: 264000
flash_size_bytes: 2097152
sys_clock_hz: 125000000
multicore: true

# GPIO
max_gpio: 29
led_pin: 25
reserved_pins: [23, 24]

# ADC
adc:
  pins: [26, 27, 28]
  resolution_bits: 12
  vref_mv: 3300

# PWM
pwm:
  pins: [0, 1, 2, 3, 4, 5, 6, 7, 8, 9, 10, 11, 12, 13, 14, 15, 16, 17, 18, 19, 20, 21, 22, 23, 24, 25, 26, 27, 28]

# Peripherals
spi:
  - instance: 0
    sck:  [2, 6, 10, 14, 18]
    mosi: [3, 7, 11, 15, 19]
    miso: [0, 4, 8, 12, 16]
    cs:   [1, 5, 9, 13, 17]
  - instance: 1
    sck:  [10, 14, 18, 22, 26]
    mosi: [11, 15, 19, 23, 27]
    miso: [12, 16, 20, 24, 28]
    cs:   [13, 17, 21, 25, 29]

i2c:
  - {instance: 0, sda: [0, 4, 8, 12, 16, 20], scl: [1, 5, 9, 13, 17, 21]}
  - {instance: 1, sda: [2, 6, 10, 14, 18, 22, 26], scl: [3, 7, 11, 15, 19, 23, 27]}

uart:
  - {instance: 0, tx: [0, 12, 16], rx: [1, 13, 17]}
  - {instance: 1, tx: [4, 8, 20, 24, 28], rx: [5, 9, 21, 25, 29]}

# Advanced / optional
pio_blocks: 2
pio_sm_per_block: 4
dma_channels: 12

# Network capabilities (for protocol subsystem)
network:
  link: []
  transport: [serial]
  ota: false
  provision: []

# Versioning
device_type: "rp2040-generic"
protocol_version: "1.1.0"
capability_version: "1.0"
firmware_version: "1.0.0"

# Human notes
notes: |
  Generic RP2040 board configuration.
  Use for custom RP2040 boards.
```

## platforms/in_development/stm32bluepill/board.yml
```yaml
# SPDX-License-Identifier: Apache-2.0
# SPDX-FileCopyrightText: Copyright (c) 2026 Revyr Labs
# Ferqon board definition — STM32 Blue Pill (STM32F103C8)
board: stm32bluepill
display_name: "STM32 Blue Pill (STM32F103C8)"
mcu: stm32f103
backend: arduino
pio_env: stm32bluepill

# Core & memory topology
core_count: 1
isr_serial_strategy: uart_rx_isr
ram_size_bytes: 20480
flash_size_bytes: 65536
sys_clock_hz: 72000000
multicore: false

# GPIO
# STM32F103C8 has 32 GPIO pins (PA0-PA15, PB0-PB15).
# Arduino core maps these as pin 0-31.
max_gpio: 31
led_pin: 13
reserved_pins: [0, 1]

# ADC
adc:
  pins: [0, 1, 2, 3, 4, 5, 6, 7, 8, 9, 10, 11, 12, 13, 14, 15]
  resolution_bits: 12
  vref_mv: 3300

# PWM
pwm:
  pins: [0, 1, 2, 3, 4, 5, 6, 7, 8, 9, 10, 11, 12, 13, 14, 15]

# Peripherals
spi:
  - instance: 0
    sck: [5]
    mosi: [7]
    miso: [6]
    cs: [4]
  - instance: 1
    sck: [3]
    mosi: [5]
    miso: [4]
    cs: [2]

i2c:
  - {instance: 0, sda: [7], scl: [6]}
  - {instance: 1, sda: [11], scl: [10]}

uart:
  - {instance: 0, tx: [9], rx: [10]}
  - {instance: 1, tx: [2], rx: [3]}
  - {instance: 2, tx: [12], rx: [13]}

# Advanced / optional
pio_blocks: 0
pio_sm_per_block: 0
dma_channels: 7

# Network capabilities
network:
  link: []
  transport: [serial]
  ota: false
  provision: []

# Versioning
device_type: "stm32-bluepill"
protocol_version: "1.1.0"
capability_version: "1.0"
firmware_version: "1.1.0"

notes: |
  STM32 Blue Pill (STM32F103C8T6).
  3 hardware UARTs — Serial, Serial1, Serial2.
  Uses Arduino STM32 core (stm32duino).
  12-bit ADC with 3.3V reference.
  72 MHz Cortex-M3.
```

## platforms/in_development/stm32f4/board.yml
```yaml
# SPDX-License-Identifier: Apache-2.0
# SPDX-FileCopyrightText: Copyright (c) 2026 Revyr Labs
# Ferqon board definition — STM32F4 Discovery
board: stm32f4
display_name: "STM32F4 Discovery"
mcu: stm32f4
backend: arduino
pio_env: stm32f4

# Core & memory topology
core_count: 1
isr_serial_strategy: uart_rx_isr
ram_size_bytes: 192000
flash_size_bytes: 1048576
sys_clock_hz: 168000000
multicore: false

# GPIO
max_gpio: 48
led_pin: 13
reserved_pins: [0, 1]

# ADC
adc:
  pins: [0, 1, 2, 3, 4, 5, 6, 7, 8, 9, 10, 11, 12, 13, 14, 15]
  resolution_bits: 12
  vref_mv: 3300

# PWM
pwm:
  pins: [0, 1, 2, 3, 4, 5, 6, 7, 8, 9, 10, 11, 12, 13, 14, 15, 16, 17, 18, 19, 20, 21, 22, 23, 24, 25, 26, 27, 28, 29, 30, 31, 32, 33, 34, 35, 36, 37, 38, 39, 40, 41, 42, 43, 44, 45, 46, 47]

# Peripherals
spi:
  - instance: 0
    sck: [5, 13]
    mosi: [7, 15]
    miso: [6, 14]
    cs: [4, 12]
  - instance: 1
    sck: [3, 10]
    mosi: [5, 12]
    miso: [4, 11]
    cs: [2, 9]
  - instance: 2
    sck: [10, 15]
    mosi: [12, 17]
    miso: [11, 16]
    cs: [9, 14]

i2c:
  - {instance: 0, sda: [7, 9], scl: [6, 8]}
  - {instance: 1, sda: [11, 13], scl: [10, 12]}

uart:
  - {instance: 0, tx: [9], rx: [10]}
  - {instance: 1, tx: [6], rx: [7]}
  - {instance: 2, tx: [2], rx: [3]}

# Advanced / optional
pio_blocks: 0
pio_sm_per_block: 0
dma_channels: 16

# Network capabilities (for protocol subsystem)
network:
  link: []
  transport: [serial]
  ota: false
  provision: []

# Versioning
device_type: "stm32f4-discovery"
protocol_version: "1.1.0"
capability_version: "1.0"
firmware_version: "1.0.0"

# Human notes
notes: |
  STM32F4 Discovery board with single-core MCU.
  Uses UART RX ISR strategy for serial handling.
```

## platforms/in_development/stm32f7/board.yml
```yaml
# SPDX-License-Identifier: Apache-2.0
# SPDX-FileCopyrightText: Copyright (c) 2024-2026 Revyr Labs
# Ferqon board definition — STM32F7 Discovery
board: stm32f7
display_name: "STM32F7 Discovery"
mcu: stm32f7
backend: arduino
pio_env: stm32f7

# Core & memory topology
core_count: 1
isr_serial_strategy: uart_rx_isr
ram_size_bytes: 320000
flash_size_bytes: 2097152
sys_clock_hz: 216000000
multicore: false

# GPIO
max_gpio: 48
led_pin: 13
reserved_pins: [0, 1]

# ADC
adc:
  pins: [0, 1, 2, 3, 4, 5, 6, 7, 8, 9, 10, 11, 12, 13, 14, 15, 16, 17, 18]
  resolution_bits: 12
  vref_mv: 3300

# PWM
pwm:
  pins: [0, 1, 2, 3, 4, 5, 6, 7, 8, 9, 10, 11, 12, 13, 14, 15, 16, 17, 18, 19, 20, 21, 22, 23, 24, 25, 26, 27, 28, 29, 30, 31, 32, 33, 34, 35, 36, 37, 38, 39, 40, 41, 42, 43, 44, 45, 46, 47]

# Peripherals
spi:
  - instance: 0
    sck:  [5, 13]
    mosi: [7, 15]
    miso: [6, 14]
    cs:   [4, 12]
  - instance: 1
    sck:  [3, 10]
    mosi: [5, 12]
    miso: [4, 11]
    cs:   [2, 9]
  - instance: 2
    sck:  [10, 15]
    mosi: [12, 17]
    miso: [11, 16]
    cs:   [9, 14]
  - instance: 3
    sck:  [2, 15]
    mosi: [3, 16]
    miso: [4, 17]
    cs:   [5, 18]

i2c:
  - {instance: 0, sda: [7, 9], scl: [6, 8]}
  - {instance: 1, sda: [11, 13], scl: [10, 12]}
  - {instance: 2, sda: [14, 16], scl: [15, 17]}
  - {instance: 3, sda: [18, 20], scl: [19, 21]}

uart:
  - {instance: 0, tx: [9], rx: [10]}
  - {instance: 1, tx: [6], rx: [7]}
  - {instance: 2, tx: [2], rx: [3]}
  - {instance: 3, tx: [10], rx: [11]}
  - {instance: 4, tx: [12], rx: [13]}
  - {instance: 5, tx: [14], rx: [15]}

# Advanced / optional
pio_blocks: 0
pio_sm_per_block: 0
dma_channels: 16

# Network capabilities (for protocol subsystem)
network:
  link: []
  transport: [serial]
  ota: false
  provision: []

# Versioning
device_type: "stm32f7-discovery"
protocol_version: "1.1.0"
capability_version: "1.0"
firmware_version: "1.0.0"

# Human notes
notes: |
  STM32F7 Discovery board with expanded peripheral options.
  Uses UART RX ISR strategy for serial handling.
```

## platforms/in_development/teensy41/board.yml
```yaml
# SPDX-License-Identifier: Apache-2.0
# SPDX-FileCopyrightText: Copyright (c) 2024-2026 Revyr Labs
# Ferqon board definition — Teensy 4.1
board: teensy41
display_name: "Teensy 4.1"
mcu: imxrt1062
backend: arduino
pio_env: teensy41

# Core & memory topology
core_count: 1
isr_serial_strategy: uart_rx_isr
ram_size_bytes: 1024000
flash_size_bytes: 8388608
sys_clock_hz: 600000000
multicore: false

# GPIO
max_gpio: 55
led_pin: 13
reserved_pins: [54]

# ADC
adc:
  pins: [14, 15, 16, 17, 18, 19, 20, 21, 22, 23, 24, 25, 26]
  resolution_bits: 12
  vref_mv: 3300

# PWM
pwm:
  pins: [0, 1, 2, 3, 4, 5, 6, 7, 8, 9, 10, 11, 12, 14, 15, 16, 17, 18, 19, 20, 21, 22, 23, 24, 25, 26, 27, 28, 29, 30, 31, 32, 33, 34, 35, 36, 37, 38, 39, 40, 41, 42, 43, 44, 45, 46, 47, 48, 49, 50, 51, 52, 53, 54]

# Peripherals
spi:
  - instance: 0
    sck:  [13]
    mosi: [11]
    miso: [12]
    cs:   [10]
  - instance: 1
    sck:  [27]
    mosi: [26]
    miso: [28]
    cs:   [25]
  - instance: 2
    sck:  [21]
    mosi: [20]
    miso: [19]
    cs:   [18]

i2c:
  - {instance: 0, sda: [18], scl: [19]}
  - {instance: 1, sda: [17], scl: [16]}
  - {instance: 2, sda: [3], scl: [4]}
  - {instance: 3, sda: [24], scl: [25]}

uart:
  - {instance: 0, tx: [1], rx: [0]}
  - {instance: 1, tx: [14], rx: [15]}
  - {instance: 2, tx: [8], rx: [7]}
  - {instance: 3, tx: [31], rx: [32]}
  - {instance: 4, tx: [33], rx: [34]}
  - {instance: 5, tx: [35], rx: [36]}
  - {instance: 6, tx: [37], rx: [38]}
  - {instance: 7, tx: [48], rx: [49]}
  - {instance: 8, tx: [52], rx: [51]}

# Advanced / optional
pio_blocks: 0
pio_sm_per_block: 0
dma_channels: 32

# Network capabilities (for protocol subsystem)
network:
  link: []
  transport: [serial]
  ota: false
  provision: []

# Versioning
device_type: "teensy41"
protocol_version: "1.1.0"
capability_version: "1.0"
firmware_version: "1.0.0"

# Human notes
notes: |
  Teensy 4.1 with expanded GPIO and flash memory.
  Uses UART RX ISR strategy for serial handling.
```

## platforms/pico/board.yml
```yaml
# Ferqon board definition — RP2040 Raspberry Pi Pico
board: pico
display_name: "Raspberry Pi Pico"
mcu: rp2040
backend: arduino          # arduino | pico-sdk | idf | zephyr
pio_env: pico_arduino

# Core & memory topology
core_count: 2
isr_serial_strategy: uart_rx_isr     # multicore | uart_rx_isr
ram_size_bytes: 264000
flash_size_bytes: 2097152
sys_clock_hz: 125000000
multicore: false

# GPIO
max_gpio: 29
led_pin: 25
reserved_pins: [23, 24]

# ADC
adc:
  pins: [26, 27, 28]
  resolution_bits: 12
  vref_mv: 3300

# PWM
pwm:
  pins: [0, 1, 2, 3, 4, 5, 6, 7, 8, 9, 10, 11, 12, 13, 14, 15,
         16, 17, 18, 19, 20, 21, 22, 23, 24, 25, 26, 27, 28]

# Peripherals
spi:
  - instance: 0
    sck:  [2, 6, 10, 14, 18]
    mosi: [3, 7, 11, 15, 19]
    miso: [0, 4, 8, 12, 16]
    cs:   [1, 5, 9, 13, 17]
  - instance: 1
    sck:  [10, 14, 18, 22, 26]
    mosi: [11, 15, 19, 23, 27]
    miso: [12, 16, 20, 24, 28]
    cs:   [13, 17, 21, 25, 29]

i2c:
  - {instance: 0, sda: [0, 4, 8, 12, 16, 20], scl: [1, 5, 9, 13, 17, 21]}
  - {instance: 1, sda: [2, 6, 10, 14, 18, 22, 26], scl: [3, 7, 11, 15, 19, 23, 27]}

uart:
  - {instance: 0, tx: [0, 12, 16], rx: [1, 13, 17]}
  - {instance: 1, tx: [4, 8, 20, 24, 28], rx: [5, 9, 21, 25, 29]}

# Advanced / optional
pio_blocks: 2
pio_sm_per_block: 4
dma_channels: 12

# Network capabilities (for protocol subsystem)
network:
  link: []                 # wifi, ethernet, ble, or []
  transport: [serial]      # mqtt, websocket, serial
  ota: false
  provision: []            # softap, ble, or []

# Versioning
device_type: "pico-rp2040"
protocol_version: "2.0"
capability_version: "1.0"
firmware_version: "1.0.0"

# Human notes (appear in docs, not in headers)
notes: |
  Pins 23 and 24 are not broken out on the standard Pico board.
  Pin 25 drives the onboard LED.
```
